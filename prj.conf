## CMakeLists.txt
```
# SPDX-License-Identifier: Apache-2.0

cmake_minimum_required(VERSION 3.20.0)
find_package(Zephyr REQUIRED HINTS $ENV{ZEPHYR_BASE})
project(oxygen2)

target_sources(app PRIVATE src/main.c src/lcd.c src/fonts.c src/oxygen_sensor.c src/turbidity_sensor.c)
```

## prj.conf
```kconfig
CONFIG_SERIAL=y
CONFIG_UART_CONSOLE=y
CONFIG_UART_INTERRUPT_DRIVEN=y
CONFIG_NEWLIB_LIBC=y
CONFIG_GPIO=y

CONFIG_CBPRINTF_FP_SUPPORT=y

# For Wireless Communication
CONFIG_BT=y
CONFIG_BT_PERIPHERAL=y
CONFIG_BT_GATT_DYNAMIC_DB=y
CONFIG_BT_DEVICE_NAME="Oxygen2"
CONFIG_BT_MAX_CONN=1

CONFIG_MAIN_STACK_SIZE=4096

# Logging
CONFIG_LOG=y
CONFIG_LOG_BACKEND_RTT=y

# SEGGER RTT Logging for debug (add these)
CONFIG_USE_SEGGER_RTT=y
CONFIG_SEGGER_RTT_BUFFER_SIZE_UP=1024
CONFIG_SEGGER_RTT_BUFFER_SIZE_DOWN=16

CONFIG_LOG_BACKEND_UART=n   # (optional, to avoid UART logging)

CONFIG_ADC=y
```

## nrf52dk_nrf52832.overlay
```dts
// To get started, press Ctrl+Space to bring up the completion menu and view the available nodes.

// You can also use the buttons in the sidebar to perform actions on nodes.
// Actions currently available include:

// * Enabling / disabling the node
// * Adding the bus to a bus
// * Removing the node
// * Connecting ADC channels

// For more help, browse the DeviceTree documentation at https://docs.zephyrproject.org/latest/guides/dts/index.html
// You can also visit the nRF DeviceTree extension documentation at https://docs.nordicsemi.com/bundle/nrf-connect-vscode/page/guides/ncs_configure_app.html#devicetree-support-in-the-extension


&uart0 {
    status = "okay";
    current-speed = <9600>;
    parity = "none";
    stop-bits = "1";
    pinctrl-0 = <&uart0_default>;
    pinctrl-1 = <&uart0_sleep>;
    pinctrl-names = "default", "sleep";
};
```

## src/main.c
```c
#include <zephyr/kernel.h>
#include <zephyr/sys/printk.h>
#include <zephyr/drivers/uart.h>
#include <zephyr/drivers/adc.h>
#include <zephyr/device.h>
#include <zephyr/drivers/gpio.h>
#include <string.h>
#include <stdlib.h>
#include <stdio.h>
#include <nrfx_saadc.h>

#include "oxygen_sensor.h"
#include "turbidity_sensor.h"

#include "fonts.h"
#include "lcd.h"

#include <zephyr/types.h>
#include <zephyr/bluetooth/bluetooth.h>
#include <zephyr/bluetooth/hci.h>
#include <zephyr/bluetooth/gatt.h>
#include <zephyr/bluetooth/uuid.h>

#define S0_PIN 11 // Selector pin (P0.11 -> 74HC4052 S0)
#define TURB_DE_PIN 25 // MAX3485 DE (P0.25)
#define BUZZER_PIN 24


#define BT_UUID_WQ_SERVICE_VAL \
    BT_UUID_128_ENCODE(0x12345678, 0x1234, 0x5678, 0x1234, 0x56789abcdef0)
#define BT_UUID_WQ_SENSOR_VAL \
    BT_UUID_128_ENCODE(0x12345678, 0x1234, 0x5678, 0x1234, 0x56789abcdef1)
#define BT_UUID_WQ_O2_THRESH_VAL \
    BT_UUID_128_ENCODE(0x12345678, 0x1234, 0x5678, 0x1234, 0x56789abcdef2)
#define BT_UUID_WQ_SAT_THRESH_VAL \
    BT_UUID_128_ENCODE(0x12345678, 0x1234, 0x5678, 0x1234, 0x56789abcdef3)
#define BT_UUID_WQ_TEMP_THRESH_VAL \
    BT_UUID_128_ENCODE(0x12345678, 0x1234, 0x5678, 0x1234, 0x56789abcdef4)

#define ADC_NODE        DT_NODELABEL(adc)
#define ADC_CHANNEL_ID  0
#define ADC_RESOLUTION  10
#define ADC_GAIN        ADC_GAIN_1_6
#define ADC_REFERENCE   ADC_REF_INTERNAL
#define ADC_BUFFER_SIZE 1

static int16_t adc_sample_buffer[ADC_BUFFER_SIZE];

static const struct adc_channel_cfg my_channel_cfg = {
    .gain             = ADC_GAIN_1_6,
    .reference        = ADC_REF_INTERNAL,
    .acquisition_time = ADC_ACQ_TIME_DEFAULT,
    .channel_id       = ADC_CHANNEL_ID,
#if defined(CONFIG_ADC_CONFIGURABLE_INPUTS)
    .input_positive   = NRF_SAADC_INPUT_AIN0,
#endif
};

float read_battery_voltage(const struct device *adc_dev)
{
    struct adc_sequence sequence = {
        .channels    = BIT(ADC_CHANNEL_ID),
        .buffer      = adc_sample_buffer,
        .buffer_size = sizeof(adc_sample_buffer),
        .resolution  = ADC_RESOLUTION,
    };

    int ret = adc_read(adc_dev, &sequence);
    if (ret) {
        printk("ADC read err %d\n", ret);
        return -1.0f;
    }

    int16_t raw = adc_sample_buffer[0];
    float v_ain = ((float)raw / 1023.0f) * 3.6f;
    float v_bat = v_ain * ((30.0f + 100.0f) / 100.0f);
    return v_bat;
}

static bool notify_enabled = false;
static struct bt_uuid_128 wq_service_uuid   = BT_UUID_INIT_128(BT_UUID_WQ_SERVICE_VAL);
static struct bt_uuid_128 wq_sensor_uuid    = BT_UUID_INIT_128(BT_UUID_WQ_SENSOR_VAL);
static struct bt_uuid_128 wq_o2_thresh_uuid = BT_UUID_INIT_128(BT_UUID_WQ_O2_THRESH_VAL);
static struct bt_uuid_128 wq_sat_thresh_uuid= BT_UUID_INIT_128(BT_UUID_WQ_SAT_THRESH_VAL);
static struct bt_uuid_128 wq_temp_thresh_uuid=BT_UUID_INIT_128(BT_UUID_WQ_TEMP_THRESH_VAL);

// Data [O2, Sat, Temp, Battery %]
static float sensor_data[4] = {0};
static float o2_thresh = 190.0;
static float sat_thresh = 80.0;
static float temp_thresh = 25.0;

// CCCD for notifications
static void sensor_ccc_cfg_changed(const struct bt_gatt_attr *attr, uint16_t value)
{
    ARG_UNUSED(attr);
    notify_enabled = (value == BT_GATT_CCC_NOTIFY);
    printk("Notify enabled: %d\n", notify_enabled);
}

// BLE read/write handlers
static ssize_t read_o2_thresh(struct bt_conn *conn, const struct bt_gatt_attr *attr, void *buf, uint16_t len, uint16_t offset)
{ return bt_gatt_attr_read(conn, attr, buf, len, offset, &o2_thresh, sizeof(o2_thresh)); }
static ssize_t write_o2_thresh(struct bt_conn *conn, const struct bt_gatt_attr *attr, const void *buf, uint16_t len, uint16_t offset)
{
    if (len != sizeof(o2_thresh)) return BT_GATT_ERR(BT_ATT_ERR_INVALID_ATTRIBUTE_LEN);
    memcpy(&o2_thresh, buf, sizeof(o2_thresh));
    printk("BLE: O2 Threshold updated to %.2f uM\n", o2_thresh);
    return len;
}
static ssize_t read_sat_thresh(struct bt_conn *conn, const struct bt_gatt_attr *attr, void *buf, uint16_t len, uint16_t offset)
{ return bt_gatt_attr_read(conn, attr, buf, len, offset, &sat_thresh, sizeof(sat_thresh)); }
static ssize_t write_sat_thresh(struct bt_conn *conn, const struct bt_gatt_attr *attr, const void *buf, uint16_t len, uint16_t offset)
{
    if (len != sizeof(sat_thresh)) return BT_GATT_ERR(BT_ATT_ERR_INVALID_ATTRIBUTE_LEN);
    memcpy(&sat_thresh, buf, sizeof(sat_thresh));
    printk("BLE: Saturation Threshold updated to %.2f %%\n", sat_thresh);
    return len;
}
static ssize_t read_temp_thresh(struct bt_conn *conn, const struct bt_gatt_attr *attr, void *buf, uint16_t len, uint16_t offset)
{ return bt_gatt_attr_read(conn, attr, buf, len, offset, &temp_thresh, sizeof(temp_thresh)); }
static ssize_t write_temp_thresh(struct bt_conn *conn, const struct bt_gatt_attr *attr, const void *buf, uint16_t len, uint16_t offset)
{
    if (len != sizeof(temp_thresh)) return BT_GATT_ERR(BT_ATT_ERR_INVALID_ATTRIBUTE_LEN);
    memcpy(&temp_thresh, buf, sizeof(temp_thresh));
    printk("BLE: Temperature Threshold updated to %.2f C\n", temp_thresh);
    return len;
}

// Custom Read Handler for Sensor Data
static ssize_t read_sensor_data(struct bt_conn *conn, const struct bt_gatt_attr *attr,
                                void *buf, uint16_t len, uint16_t offset)
{
    return bt_gatt_attr_read(conn, attr, buf, len, offset, sensor_data, sizeof(sensor_data));
}

// GATT Table
BT_GATT_SERVICE_DEFINE(wq_svc,
    BT_GATT_PRIMARY_SERVICE(&wq_service_uuid),
    BT_GATT_CHARACTERISTIC(&wq_sensor_uuid.uuid,
        BT_GATT_CHRC_READ | BT_GATT_CHRC_NOTIFY,
        BT_GATT_PERM_READ,
        read_sensor_data, NULL, sensor_data),
    BT_GATT_CCC(sensor_ccc_cfg_changed, BT_GATT_PERM_READ | BT_GATT_PERM_WRITE),

    BT_GATT_CHARACTERISTIC(&wq_o2_thresh_uuid.uuid,
        BT_GATT_CHRC_READ | BT_GATT_CHRC_WRITE,
        BT_GATT_PERM_READ | BT_GATT_PERM_WRITE,
        read_o2_thresh, write_o2_thresh, &o2_thresh),
    BT_GATT_CHARACTERISTIC(&wq_sat_thresh_uuid.uuid,
        BT_GATT_CHRC_READ | BT_GATT_CHRC_WRITE,
        BT_GATT_PERM_READ | BT_GATT_PERM_WRITE,
        read_sat_thresh, write_sat_thresh, &sat_thresh),
    BT_GATT_CHARACTERISTIC(&wq_temp_thresh_uuid.uuid,
        BT_GATT_CHRC_READ | BT_GATT_CHRC_WRITE,
        BT_GATT_PERM_READ | BT_GATT_PERM_WRITE,
        read_temp_thresh, write_temp_thresh, &temp_thresh),
);

void uart_flush(const struct device *uart_dev) {
    unsigned char c;
    while (uart_poll_in(uart_dev, &c) == 0) {
        // discard
    }
}

void main(void) {
    const struct device *uart_dev = DEVICE_DT_GET(DT_NODELABEL(uart0));
    const struct device *gpio_dev = DEVICE_DT_GET(DT_NODELABEL(gpio0));
    if (!device_is_ready(uart_dev) || !device_is_ready(gpio_dev)) {
        printk("UART0 or GPIO not ready!\n");
        return;
    }

    const struct device *adc_dev = DEVICE_DT_GET(ADC_NODE);
    if (!device_is_ready(adc_dev)) {
        printk("ADC device not ready!\n");
        return;
    }

    adc_channel_setup(adc_dev, &my_channel_cfg);

    gpio_pin_configure(gpio_dev, S0_PIN, GPIO_OUTPUT_ACTIVE); //Sets to 1
    gpio_pin_configure(gpio_dev, TURB_DE_PIN, GPIO_OUTPUT_INACTIVE); //Sets to 0
    gpio_pin_configure(gpio_dev, BUZZER_PIN, GPIO_OUTPUT_INACTIVE);//Sets to 0


    lcd_init(gpio_dev);
    lcd_clear(gpio_dev);

    int err;
    printk("Starting Oxygen2 BLE example...\n");
    err = bt_enable(NULL);
    printk("bt_enable returned %d\n", err);
    if (err) {
        printk("Bluetooth init failed (err %d)\n", err);
        return;
    }
    printk("Bluetooth initialized\n");

    struct bt_le_adv_param adv_params = {
        .options = BT_LE_ADV_OPT_CONNECTABLE,
        .interval_min = BT_GAP_ADV_FAST_INT_MIN_2,
        .interval_max = BT_GAP_ADV_FAST_INT_MAX_2,
    };
    const struct bt_data ad[] = {
        BT_DATA_BYTES(BT_DATA_FLAGS, (BT_LE_AD_GENERAL | BT_LE_AD_NO_BREDR)),
        BT_DATA(BT_DATA_NAME_COMPLETE, CONFIG_BT_DEVICE_NAME, sizeof(CONFIG_BT_DEVICE_NAME) - 1),
    };
    err = bt_le_adv_start(&adv_params, ad, ARRAY_SIZE(ad), NULL, 0);
    if (err) {
        printk("Advertising failed to start (err %d)\n", err);
        return;
    }
    printk("Advertising started\n");

    float conc = 0, sat = 0, temp = 0;
    gpio_pin_set(gpio_dev, S0_PIN, 1); //For Selecting Oxygen Sensor
    
    //float turbidity = 0;
    //gpio_pin_set(gpio_dev, S0_PIN, 0); //For Selecting Turbidity Sensor


    while (1) {
        /*
        turbidity_read_from_uart(uart_dev, gpio_dev, TURB_DE_PIN, &turbidity);
        printk("Turbidity: %d.%01d NTU\n",
            (int)turbidity, ((int)(turbidity * 10)) % 10
        );
        char line4[32];
        snprintf(line4, sizeof(line4), "Turb: %d.%01d NTU", (int)turbidity, ((int)(turbidity*10))%10);
        lcd_clear(gpio_dev);
        lcd_draw_text(gpio_dev, 0, 0, line4);
        */


        
        float vbat = read_battery_voltage(adc_dev);
        int battery_percent = (int)(((vbat - 3.0) / (4.2 - 3.0)) * 100);
        if (battery_percent > 100) battery_percent = 100;
        if (battery_percent < 0) battery_percent = 0;

        if (oxygen_read_from_uart(uart_dev, &conc, &sat, &temp)) {
            printk("PARSED: O2=%d.%02d uM  Sat=%d.%02d%%  T=%d.%02d C Battery=%d%%\n",
                (int)conc,   ((int)(conc * 100)) % 100,
                (int)sat,    ((int)(sat  * 100)) % 100,
                (int)temp,   ((int)(temp * 100)) % 100,
                battery_percent
            );
            
            sensor_data[0] = conc;
            sensor_data[1] = sat;
            sensor_data[2] = temp;
            sensor_data[3] = (float)battery_percent;
            
            // --- Temperature alert logic ---
            if (conc < o2_thresh) {
                gpio_pin_set(gpio_dev, BUZZER_PIN, 1); // Buzzer ON
                printk("ALERT: Oxygen below threshold! Buzzer ON\n");
            } else {
                gpio_pin_set(gpio_dev, BUZZER_PIN, 0); // Buzzer OFF
            }

            // Print and update
            char line1[32], line2[32], line3[32], line5[32];
            snprintf(line1, sizeof(line1), "O2: %d.%02d uM", (int)conc, ((int)(conc*100))%100);
            snprintf(line2, sizeof(line2), "Sat: %d.%02d%%", (int)sat, ((int)(sat*100))%100);
            snprintf(line3, sizeof(line3), "T: %d.%02d C", (int)temp, ((int)(temp*100))%100);
            snprintf(line5, sizeof(line5), "Battery: %d%%", battery_percent);

            lcd_clear(gpio_dev);
            lcd_draw_text(gpio_dev, 0, 0, line1);
            lcd_draw_text(gpio_dev, 1, 0, line2);
            lcd_draw_text(gpio_dev, 2, 0, line3);
            lcd_draw_text(gpio_dev, 3, 0, line5);

            if (notify_enabled) {
                int err1 = bt_gatt_notify(NULL, &wq_svc.attrs[1], sensor_data, sizeof(sensor_data));
                if (err1) {
                    printk("bt_gatt_notify(sensor_data) failed: %d\n", err1);
                }
            }
        }
       
        k_msleep(1); //1 seconds for Oxygen Sensor
        //k_msleep(20000); //20 seconds for Turbidity Sensor
    }
}
```

## src/fonts.c
```c
#include "fonts.h"

// Font 8x8 - Large
const unsigned char font8[95][8] = {
    {0b00000000,0b00000000,0b00000000,0b00000000,0b00000000,0b00000000,0b00000000,0b00000000}, //
	{0b00000000,0b00000110,0b01011111,0b01011111,0b00000110,0b00000000,0b00000000,0b00000000}, // !
	{0b00000000,0b00000111,0b00000111,0b00000000,0b00000111,0b00000111,0b00000000,0b00000000}, // "
	{0b00010100,0b01111111,0b01111111,0b00010100,0b01111111,0b01111111,0b00010100,0b00000000}, // #
	{0b00100100,0b00101110,0b01101011,0b01101011,0b00111010,0b00010010,0b00000000,0b00000000}, // $
	{0b01000110,0b01100110,0b00110000,0b00011000,0b00001100,0b01100110,0b01100010,0b00000000}, // %
	{0b00110000,0b01111010,0b01001111,0b01011101,0b00110111,0b01111010,0b01001000,0b00000000}, // &
	{0b00000100,0b00000111,0b00000011,0b00000000,0b00000000,0b00000000,0b00000000,0b00000000}, // '
	{0b00000000,0b00011100,0b00111110,0b01100011,0b01000001,0b00000000,0b00000000,0b00000000}, // (
	{0b00000000,0b01000001,0b01100011,0b00111110,0b00011100,0b00000000,0b00000000,0b00000000}, // )
	{0b00001000,0b00101010,0b00111110,0b00011100,0b00011100,0b00111110,0b00101010,0b00001000}, // *
	{0b00001000,0b00001000,0b00111110,0b00111110,0b00001000,0b00001000,0b00000000,0b00000000}, // +
	{0b00000000,0b10100000,0b11100000,0b01100000,0b00000000,0b00000000,0b00000000,0b00000000}, // ,
	{0b00001000,0b00001000,0b00001000,0b00001000,0b00001000,0b00001000,0b00000000,0b00000000}, // -
	{0b00000000,0b00000000,0b01100000,0b01100000,0b00000000,0b00000000,0b00000000,0b00000000}, // .
	{0b01100000,0b00110000,0b00011000,0b00001100,0b00000110,0b00000011,0b00000001,0b00000000}, // /
	{0b00111110,0b01111111,0b01011001,0b01001101,0b01111111,0b00111110,0b00000000,0b00000000}, // 0
	{0b01000010,0b01000010,0b01111111,0b01111111,0b01000000,0b01000000,0b00000000,0b00000000}, // 1
	{0b01100010,0b01110011,0b01011001,0b01001001,0b01101111,0b01100110,0b00000000,0b00000000}, // 2
	{0b00100010,0b01100011,0b01001001,0b01001001,0b01111111,0b00110110,0b00000000,0b00000000}, // 3
	{0b00011000,0b00011100,0b00010110,0b00010011,0b01111111,0b01111111,0b00010000,0b00000000}, // 4
	{0b00100111,0b01100111,0b01000101,0b01000101,0b01111101,0b00111001,0b00000000,0b00000000}, // 5
	{0b00111100,0b01111110,0b01001011,0b01001001,0b01111001,0b00110000,0b00000000,0b00000000}, // 6
	{0b00000011,0b01100011,0b01110001,0b00011001,0b00001111,0b00000111,0b00000000,0b00000000}, // 7
	{0b00110110,0b01111111,0b01001001,0b01001001,0b01111111,0b00110110,0b00000000,0b00000000}, // 8
	{0b00000110,0b01001111,0b01001001,0b01101001,0b00111111,0b00011110,0b00000000,0b00000000}, // 9
	{0b00000000,0b00000000,0b01101100,0b01101100,0b00000000,0b00000000,0b00000000,0b00000000}, // :
	{0b00000000,0b10100000,0b11101100,0b01101100,0b00000000,0b00000000,0b00000000,0b00000000}, // ;
	{0b00001000,0b00011100,0b00110110,0b01100011,0b01000001,0b00000000,0b00000000,0b00000000}, // <
	{0b00010100,0b00010100,0b00010100,0b00010100,0b00010100,0b00010100,0b00000000,0b00000000}, // =
	{0b00000000,0b01000001,0b01100011,0b00110110,0b00011100,0b00001000,0b00000000,0b00000000}, // >
	{0b00000010,0b00000011,0b01010001,0b01011001,0b00001111,0b00000110,0b00000000,0b00000000}, // ?
	{0b00111110,0b01111111,0b01000001,0b01011101,0b01011101,0b00011111,0b00011110,0b00000000}, // @
	{0b01111100,0b01111110,0b00010011,0b00010011,0b01111110,0b01111100,0b00000000,0b00000000}, // A
	{0b01000001,0b01111111,0b01111111,0b01001001,0b01001001,0b01111111,0b00110110,0b00000000}, // B
	{0b00011100,0b00111110,0b01100011,0b01000001,0b01000001,0b01100011,0b00100010,0b00000000}, // C
	{0b01000001,0b01111111,0b01111111,0b01000001,0b01100011,0b01111111,0b00011100,0b00000000}, // D
	{0b01000001,0b01111111,0b01111111,0b01001001,0b01011101,0b01000001,0b01100011,0b00000000}, // E
	{0b01000001,0b01111111,0b01111111,0b01001001,0b00011101,0b00000001,0b00000011,0b00000000}, // F
	{0b00011100,0b00111110,0b01100011,0b01000001,0b01010001,0b01110011,0b01110010,0b00000000}, // G
	{0b01111111,0b01111111,0b00001000,0b00001000,0b01111111,0b01111111,0b00000000,0b00000000}, // H
	{0b00000000,0b01000001,0b01111111,0b01111111,0b01000001,0b00000000,0b00000000,0b00000000}, // I
	{0b00110000,0b01110000,0b01000000,0b01000001,0b01111111,0b00111111,0b00000001,0b00000000}, // J
	{0b01000001,0b01111111,0b01111111,0b00001000,0b00011100,0b01110111,0b01100011,0b00000000}, // K
	{0b01000001,0b01111111,0b01111111,0b01000001,0b01000000,0b01100000,0b01110000,0b00000000}, // L
	{0b01111111,0b01111111,0b00000110,0b00001100,0b00000110,0b01111111,0b01111111,0b00000000}, // M
	{0b01111111,0b01111111,0b00000110,0b00001100,0b00011000,0b01111111,0b01111111,0b00000000}, // N
	{0b00011100,0b00111110,0b01100011,0b01000001,0b01100011,0b00111110,0b00011100,0b00000000}, // O
	{0b01000001,0b01111111,0b01111111,0b01001001,0b00001001,0b00001111,0b00000110,0b00000000}, // P
	{0b00011110,0b00111111,0b00100001,0b01110001,0b01111111,0b01011110,0b00000000,0b00000000}, // Q
	{0b01000001,0b01111111,0b01111111,0b00011001,0b00111001,0b01101111,0b01000110,0b00000000}, // R
	{0b00100110,0b01100111,0b01001101,0b01011001,0b01111011,0b00110010,0b00000000,0b00000000}, // S
	{0b00000011,0b01000001,0b01111111,0b01111111,0b01000001,0b00000011,0b00000000,0b00000000}, // T
	{0b01111111,0b01111111,0b01000000,0b01000000,0b01111111,0b01111111,0b00000000,0b00000000}, // U
	{0b00011111,0b00111111,0b01100000,0b01100000,0b00111111,0b00011111,0b00000000,0b00000000}, // V
	{0b01111111,0b01111111,0b00110000,0b00011000,0b00110000,0b01111111,0b01111111,0b00000000}, // W
	{0b01100011,0b01110111,0b00011100,0b00001000,0b00011100,0b01110111,0b01100011,0b00000000}, // X
	{0b00000111,0b01001111,0b01111000,0b01111000,0b01001111,0b00000111,0b00000000,0b00000000}, // Y
	{0b01100111,0b01110011,0b01011001,0b01001101,0b01000111,0b01100011,0b01110001,0b00000000}, // Z
	{0b00000000,0b01111111,0b01111111,0b01000001,0b01000001,0b00000000,0b00000000,0b00000000}, // [
	{0b00000001,0b00000011,0b00000110,0b00001100,0b00011000,0b00110000,0b01100000,0b00000000}, // "\"
	{0b00000000,0b01000001,0b01000001,0b01111111,0b01111111,0b00000000,0b00000000,0b00000000}, // ]
	{0b00001000,0b00001100,0b00000110,0b00000011,0b00000110,0b00001100,0b00001000,0b00000000}, // ^
	{0b10000000,0b10000000,0b10000000,0b10000000,0b10000000,0b10000000,0b10000000,0b10000000}, // _
	{0b00000000,0b00000000,0b00000011,0b00000111,0b00000100,0b00000000,0b00000000,0b00000000}, // `
	{0b00100000,0b01110100,0b01010100,0b01010100,0b00111100,0b01111000,0b01000000,0b00000000}, // a
	{0b01000001,0b00111111,0b01111111,0b01000100,0b01000100,0b01111100,0b00111000,0b00000000}, // b
	{0b00111000,0b01111100,0b01000100,0b01000100,0b01101100,0b00101000,0b00000000,0b00000000}, // c
	{0b00110000,0b01111000,0b01001000,0b01001001,0b00111111,0b01111111,0b01000000,0b00000000}, // d
	{0b00111000,0b01111100,0b01010100,0b01010100,0b01011100,0b00011000,0b00000000,0b00000000}, // e
	{0b01001000,0b01111110,0b01111111,0b01001001,0b00000011,0b00000010,0b00000000,0b00000000}, // f
	{0b10011000,0b10111100,0b10100100,0b10100100,0b11111000,0b01111100,0b00000100,0b00000000}, // g
	{0b01000001,0b01111111,0b01111111,0b00001000,0b00000100,0b01111100,0b01111000,0b00000000}, // h
	{0b00000000,0b01000100,0b01111101,0b01111101,0b01000000,0b00000000,0b00000000,0b00000000}, // i
	{0b01000000,0b11000100,0b10000100,0b11111101,0b01111101,0b00000000,0b00000000,0b00000000}, // j
	{0b01000001,0b01111111,0b01111111,0b00010000,0b00111000,0b01101100,0b01000100,0b00000000}, // k
	{0b00000000,0b01000001,0b01111111,0b01111111,0b01000000,0b00000000,0b00000000,0b00000000}, // l
	{0b01111100,0b01111100,0b00001100,0b00011000,0b00001100,0b01111100,0b01111000,0b00000000}, // m
	{0b01111100,0b01111100,0b00000100,0b00000100,0b01111100,0b01111000,0b00000000,0b00000000}, // n
	{0b00111000,0b01111100,0b01000100,0b01000100,0b01111100,0b00111000,0b00000000,0b00000000}, // o
	{0b10000100,0b11111100,0b11111000,0b10100100,0b00100100,0b00111100,0b00011000,0b00000000}, // p
	{0b00011000,0b00111100,0b00100100,0b10100100,0b11111000,0b11111100,0b10000100,0b00000000}, // q
	{0b01000100,0b01111100,0b01111000,0b01000100,0b00011100,0b00011000,0b00000000,0b00000000}, // r
	{0b01001000,0b01011100,0b01010100,0b01010100,0b01110100,0b00100100,0b00000000,0b00000000}, // s
	{0b00000000,0b00000100,0b00111110,0b01111111,0b01000100,0b00100100,0b00000000,0b00000000}, // t
	{0b00111100,0b01111100,0b01000000,0b01000000,0b00111100,0b01111100,0b01000000,0b00000000}, // u
	{0b00011100,0b00111100,0b01100000,0b01100000,0b00111100,0b00011100,0b00000000,0b00000000}, // v
	{0b00111100,0b01111100,0b01100000,0b00110000,0b01100000,0b01111100,0b00111100,0b00000000}, // w
	{0b01000100,0b01101100,0b00111000,0b00010000,0b00111000,0b01101100,0b01000100,0b00000000}, // x
	{0b10011100,0b10111100,0b10100000,0b10100000,0b11111100,0b01111100,0b00000000,0b00000000}, // y
	{0b01001100,0b01100100,0b01110100,0b01011100,0b01001100,0b01100100,0b00000000,0b00000000}, // z
	{0b00001000,0b00001000,0b00111110,0b01110111,0b01000001,0b01000001,0b00000000,0b00000000}, // {
	{0b00000000,0b00000000,0b00000000,0b01110111,0b01110111,0b00000000,0b00000000,0b00000000}, // |
	{0b01000001,0b01000001,0b01110111,0b00111110,0b00001000,0b00001000,0b00000000,0b00000000}, // }
	{0b00000010,0b00000011,0b00000001,0b00000011,0b00000010,0b00000011,0b00000001,0b00000000}, // ~
};

// Font 5x7 - normal
const unsigned char font5[95][5] = {
    {0b00000000,0b00000000,0b00000000,0b00000000,0b00000000}, //
	{0b00000000,0b00000000,0b01011111,0b00000000,0b00000000}, // !
	{0b00000000,0b00000111,0b00000000,0b00000111,0b00000000}, // "
	{0b00010100,0b01111111,0b00010100,0b01111111,0b00010100}, // #
	{0b00100100,0b00101010,0b01111111,0b00101010,0b00010010}, // $
	{0b00100011,0b00010011,0b00001000,0b01100100,0b01100010}, // %
	{0b00110110,0b01001001,0b01010101,0b00100010,0b01010000}, // &
	{0b00000000,0b00000101,0b00000011,0b00000000,0b00000000}, // '
	{0b00000000,0b00011100,0b00100010,0b01000001,0b00000000}, // (
	{0b00000000,0b01000001,0b00100010,0b00011100,0b00000000}, // )
	{0b00001000,0b00101010,0b00011100,0b00101010,0b00001000}, // *
	{0b00001000,0b00001000,0b00111110,0b00001000,0b00001000}, // +
	{0b00000000,0b01010000,0b00110000,0b00000000,0b00000000}, // ,
	{0b00001000,0b00001000,0b00001000,0b00001000,0b00001000}, // -
	{0b00000000,0b01100000,0b01100000,0b00000000,0b00000000}, // .
	{0b00100000,0b00010000,0b00001000,0b00000100,0b00000010}, // /
	{0b00111110,0b01010001,0b01001001,0b01000101,0b00111110}, // 0
	{0b00000000,0b01000010,0b01111111,0b01000000,0b00000000}, // 1
	{0b01000010,0b01100001,0b01010001,0b01001001,0b01000110}, // 2
	{0b00100001,0b01000001,0b01000101,0b01001011,0b00110001}, // 3
	{0b00011000,0b00010100,0b00010010,0b01111111,0b00010000}, // 4
	{0b00100111,0b01000101,0b01000101,0b01000101,0b00111001}, // 5
	{0b00111100,0b01001010,0b01001001,0b01001001,0b00110000}, // 6
	{0b00000001,0b01110001,0b00001001,0b00000101,0b00000011}, // 7
	{0b00110110,0b01001001,0b01001001,0b01001001,0b00110110}, // 8
	{0b00000110,0b01001001,0b01001001,0b00101001,0b00011110}, // 9
	{0b00000000,0b00110110,0b00110110,0b00000000,0b00000000}, // :
	{0b00000000,0b01010110,0b00110110,0b00000000,0b00000000}, // ;
	{0b00000000,0b00001000,0b00010100,0b00100010,0b01000001}, // <
	{0b00010100,0b00010100,0b00010100,0b00010100,0b00010100}, // =
	{0b01000001,0b00100010,0b00010100,0b00001000,0b00000000}, // >
	{0b00000010,0b00000001,0b01010001,0b00001001,0b00000110}, // ?
	{0b00110010,0b01001001,0b01111001,0b01000001,0b00111110}, // @
	{0b01111110,0b00010001,0b00010001,0b00010001,0b01111110}, // A
	{0b01111111,0b01001001,0b01001001,0b01001001,0b00110110}, // B
	{0b00111110,0b01000001,0b01000001,0b01000001,0b00100010}, // C
	{0b01111111,0b01000001,0b01000001,0b00100010,0b00011100}, // D
	{0b01111111,0b01001001,0b01001001,0b01001001,0b01000001}, // E
	{0b01111111,0b00001001,0b00001001,0b00000001,0b00000001}, // F
	{0b00111110,0b01000001,0b01000001,0b01010001,0b00110010}, // G
	{0b01111111,0b00001000,0b00001000,0b00001000,0b01111111}, // H
	{0b00000000,0b01000001,0b01111111,0b01000001,0b00000000}, // I
	{0b00100000,0b01000000,0b01000001,0b00111111,0b00000001}, // J
	{0b01111111,0b00001000,0b00010100,0b00100010,0b01000001}, // K
	{0b01111111,0b01000000,0b01000000,0b01000000,0b01000000}, // L
	{0b01111111,0b00000010,0b00000100,0b00000010,0b01111111}, // M
	{0b01111111,0b00000100,0b00001000,0b00010000,0b01111111}, // N
	{0b00111110,0b01000001,0b01000001,0b01000001,0b00111110}, // O
	{0b01111111,0b00001001,0b00001001,0b00001001,0b00000110}, // P
	{0b00111110,0b01000001,0b01010001,0b00100001,0b01011110}, // Q
	{0b01111111,0b00001001,0b00011001,0b00101001,0b01000110}, // R
	{0b01000110,0b01001001,0b01001001,0b01001001,0b00110001}, // S
	{0b00000001,0b00000001,0b01111111,0b00000001,0b00000001}, // T
	{0b00111111,0b01000000,0b01000000,0b01000000,0b00111111}, // U
	{0b00011111,0b00100000,0b01000000,0b00100000,0b00011111}, // V
	{0b01111111,0b00100000,0b00011000,0b00100000,0b01111111}, // W
	{0b01100011,0b00010100,0b00001000,0b00010100,0b01100011}, // X
	{0b00000011,0b00000100,0b01111000,0b00000100,0b00000011}, // Y
	{0b01100001,0b01010001,0b01001001,0b01000101,0b01000011}, // Z
	{0b00000000,0b00000000,0b01111111,0b01000001,0b01000001}, // [
	{0b00000010,0b00000100,0b00001000,0b00010000,0b00100000}, // "\"
	{0b01000001,0b01000001,0b01111111,0b00000000,0b00000000}, // ]
	{0b00000100,0b00000010,0b00000001,0b00000010,0b00000100}, // ^
	{0b01000000,0b01000000,0b01000000,0b01000000,0b01000000}, // _
	{0b00000000,0b00000001,0b00000010,0b00000100,0b00000000}, // `
	{0b00100000,0b01010100,0b01010100,0b01010100,0b01111000}, // a
	{0b01111111,0b01001000,0b01000100,0b01000100,0b00111000}, // b
	{0b00111000,0b01000100,0b01000100,0b01000100,0b00100000}, // c
	{0b00111000,0b01000100,0b01000100,0b01001000,0b01111111}, // d
	{0b00111000,0b01010100,0b01010100,0b01010100,0b00011000}, // e
	{0b00001000,0b01111110,0b00001001,0b00000001,0b00000010}, // f
	{0b00001000,0b00010100,0b01010100,0b01010100,0b00111100}, // g
	{0b01111111,0b00001000,0b00000100,0b00000100,0b01111000}, // h
	{0b00000000,0b01000100,0b01111101,0b01000000,0b00000000}, // i
	{0b00100000,0b01000000,0b01000100,0b00111101,0b00000000}, // j
	{0b00000000,0b01111111,0b00010000,0b00101000,0b01000100}, // k
	{0b00000000,0b01000001,0b01111111,0b01000000,0b00000000}, // l
	{0b01111100,0b00000100,0b00011000,0b00000100,0b01111000}, // m
	{0b01111100,0b00001000,0b00000100,0b00000100,0b01111000}, // n
	{0b00111000,0b01000100,0b01000100,0b01000100,0b00111000}, // o
	{0b01111100,0b00010100,0b00010100,0b00010100,0b00001000}, // p
	{0b00001000,0b00010100,0b00010100,0b00011000,0b01111100}, // q
	{0b01111100,0b00001000,0b00000100,0b00000100,0b00001000}, // r
	{0b01001000,0b01010100,0b01010100,0b01010100,0b00100000}, // s
	{0b00000100,0b00111111,0b01000100,0b01000000,0b00100000}, // t
	{0b00111100,0b01000000,0b01000000,0b00100000,0b01111100}, // u
	{0b00011100,0b00100000,0b01000000,0b00100000,0b00011100}, // v
	{0b00111100,0b01000000,0b00110000,0b01000000,0b00111100}, // w
	{0b01000100,0b00101000,0b00010000,0b00101000,0b01000100}, // x
	{0b00001100,0b01010000,0b01010000,0b01010000,0b00111100}, // y
	{0b01000100,0b01100100,0b01010100,0b01001100,0b01000100}, // z
	{0b00000000,0b00001000,0b00110110,0b01000001,0b00000000}, // {
	{0b00000000,0b00000000,0b01111111,0b00000000,0b00000000}, // |
	{0b00000000,0b01000001,0b00110110,0b00001000,0b00000000}, // }
	{0b00000010,0b00000001,0b00000011,0b00000010,0b00000001}, // ~
};

// Font 4x6 - Small
const unsigned char font4[95][4] = {
		{0b00000000,0b00000000,0b00000000,0b00000000}, //
		{0b00000000,0b01011100,0b00000000,0b00000000}, // !
		{0b00001100,0b00000000,0b00001100,0b00000000}, // "
		{0b01111100,0b00101000,0b01111100,0b00101000}, // #
		{0b01011000,0b11011100,0b01101000,0b00000000}, // $
		{0b00100100,0b00010000,0b01001000,0b00000000}, // %
		{0b00101000,0b01010100,0b00101000,0b01000000}, // &
		{0b00000000,0b00001100,0b00000000,0b00000000}, // '
		{0b00000000,0b01111000,0b10000100,0b00000000}, // (
		{0b10000100,0b01111000,0b00000000,0b00000000}, // )
		{0b01010100,0b00111000,0b01010100,0b00000000}, // *
		{0b00010000,0b01111100,0b00010000,0b00000000}, // +
		{0b10000000,0b01000000,0b00000000,0b00000000}, // ,
		{0b00010000,0b00010000,0b00010000,0b00000000}, // -
		{0b00000000,0b01000000,0b00000000,0b00000000}, // .
		{0b01100000,0b00010000,0b00001100,0b00000000}, // /
		{0b00111000,0b01010100,0b00111000,0b00000000}, // 0
		{0b01001000,0b01111100,0b01000000,0b00000000}, // 1
		{0b01001000,0b01100100,0b01011000,0b00000000}, // 2
		{0b01000100,0b01010100,0b00101100,0b00000000}, // 3
		{0b00011100,0b00010000,0b01111100,0b00000000}, // 4
		{0b01011100,0b01010100,0b00100100,0b00000000}, // 5
		{0b00111000,0b01010100,0b00100100,0b00000000}, // 6
		{0b01100100,0b00010100,0b00001100,0b00000000}, // 7
		{0b01101000,0b01010100,0b00101100,0b00000000}, // 8
		{0b01001000,0b01010100,0b00111000,0b00000000}, // 9
		{0b00000000,0b01001000,0b00000000,0b00000000}, // :
		{0b10000000,0b01001000,0b00000000,0b00000000}, // ;
		{0b00010000,0b00101000,0b01000100,0b00000000}, // <
		{0b00101000,0b00101000,0b00101000,0b00000000}, // =
		{0b01000100,0b00101000,0b00010000,0b00000000}, // >
		{0b00000100,0b01010100,0b00001000,0b00000000}, // ?
		{0b00111000,0b01000100,0b01011100,0b00000000}, // @
		{0b01111000,0b00010100,0b01111000,0b00000000}, // A
		{0b01111100,0b01010100,0b00101000,0b00000000}, // B
		{0b00111000,0b01000100,0b00101000,0b00000000}, // C
		{0b01111100,0b01000100,0b00111000,0b00000000}, // D
		{0b01111100,0b01010100,0b01000100,0b00000000}, // E
		{0b01111100,0b00010100,0b00000100,0b00000000}, // F
		{0b00111000,0b01000100,0b01110100,0b00000000}, // G
		{0b01111100,0b00010000,0b01111100,0b00000000}, // H
		{0b01000100,0b01111100,0b01000100,0b00000000}, // I
		{0b00100000,0b01000000,0b00111100,0b00000000}, // J
		{0b01111100,0b00010000,0b01101100,0b00000000}, // K
		{0b01111100,0b01000000,0b01000000,0b00000000}, // L
		{0b01111100,0b00011000,0b01111100,0b00000000}, // M
		{0b01111000,0b00010000,0b00111100,0b00000000}, // N
		{0b00111000,0b01000100,0b00111000,0b00000000}, // O
		{0b01111100,0b00010100,0b00001000,0b00000000}, // P
		{0b00111000,0b01000100,0b10111000,0b00000000}, // Q
		{0b01111100,0b00010100,0b01101000,0b00000000}, // R
		{0b01001000,0b01010100,0b00100100,0b00000000}, // S
		{0b00000100,0b01111100,0b00000100,0b00000000}, // T
		{0b01111100,0b01000000,0b01111100,0b00000000}, // U
		{0b00111100,0b01100000,0b00111100,0b00000000}, // V
		{0b01111100,0b00110000,0b01111100,0b00000000}, // W
		{0b01101100,0b00010000,0b01101100,0b00000000}, // X
		{0b00001100,0b01110000,0b00001100,0b00000000}, // Y
		{0b01100100,0b01010100,0b01001100,0b00000000}, // Z
		{0b00000000,0b01111100,0b01000100,0b00000000}, // [
		{0b00001100,0b00010000,0b01100000,0b00000000}, // "\"
		{0b01000100,0b01111100,0b00000000,0b00000000}, // ]
		{0b00001000,0b00000100,0b00001000,0b00000000}, // ^
		{0b10000000,0b10000000,0b10000000,0b00000000}, // _
		{0b00000000,0b00000100,0b00001000,0b00000000}, // `
		{0b00110000,0b01001000,0b01111000,0b00000000}, // a
		{0b01111100,0b01001000,0b00110000,0b00000000}, // b
		{0b00110000,0b01001000,0b01001000,0b00000000}, // c
		{0b00110000,0b01001000,0b01111100,0b00000000}, // d
		{0b00110000,0b01101000,0b01010000,0b00000000}, // e
		{0b00010000,0b01111000,0b00010100,0b00000000}, // f
		{0b10010000,0b10101000,0b01111000,0b00000000}, // g
		{0b01111100,0b00001000,0b01110000,0b00000000}, // h
		{0b01010000,0b01110100,0b01000000,0b00000000}, // i
		{0b10000000,0b10000000,0b01110100,0b00000000}, // j
		{0b01111100,0b00010000,0b01101000,0b00000000}, // k
		{0b01000100,0b01111100,0b01000000,0b00000000}, // l
		{0b01111000,0b00010000,0b01111000,0b00000000}, // m
		{0b01111000,0b00001000,0b01110000,0b00000000}, // n
		{0b00110000,0b01001000,0b00110000,0b00000000}, // o
		{0b11111000,0b00101000,0b00010000,0b00000000}, // p
		{0b00110000,0b01001000,0b11111000,0b00000000}, // q
		{0b01111000,0b00010000,0b00001000,0b00000000}, // r
		{0b01010000,0b01011000,0b00101000,0b00000000}, // s
		{0b00001000,0b00111100,0b01001000,0b00000000}, // t
		{0b00111000,0b01000000,0b01111000,0b00000000}, // u
		{0b00111000,0b01000000,0b00111000,0b00000000}, // v
		{0b01111000,0b00100000,0b01111000,0b00000000}, // w
		{0b01001000,0b00110000,0b01001000,0b00000000}, // x
		{0b10011000,0b10100000,0b01111000,0b00000000}, // y
		{0b01001000,0b01101000,0b01011000,0b00000000}, // z
		{0b00010000,0b01111000,0b10000100,0b00000000}, // {
		{0b00000000,0b01111100,0b00000000,0b00000000}, // |
		{0b10000100,0b01111000,0b00010000,0b00000000}, // }
		{0b00001000,0b00000100,0b00001000,0b00000100}, // ~
};
```

## src/fonts.h
```c
/*
 * fonts.h
 *
 * Library of fonts
 * Large: 8x8, normal: 5x7 and small: 4x7
 */

#ifndef FONTS_H_
#define FONTS_H_

extern const unsigned char font8[95][8];
extern const unsigned char font5[95][5];
extern const unsigned char font4[95][4];

#endif // FONTS_H_
```

## src/lcd.c
```c
#include <zephyr/device.h>
#include <zephyr/drivers/gpio.h>
#include <zephyr/kernel.h>
#include <string.h>
#include "lcd.h"
#include "fonts.h"

// LCD Pin Definitions (update as needed)
#define LCD_CS_PIN    3   // Chip Select
#define LCD_RES_PIN   4   // Reset
#define LCD_A0_PIN    28  // Data/Command
#define LCD_SCL_PIN   29  // Clock
#define LCD_SI_PIN    30  // Data In


// Bit-banged SPI send (command/data)
static void spi_send(const struct device *gpio_dev, uint8_t byte, bool is_data) {
    gpio_pin_set(gpio_dev, LCD_CS_PIN, 0);
    gpio_pin_set(gpio_dev, LCD_A0_PIN, is_data ? 1 : 0);

    for (int bit = 7; bit >= 0; bit--) {
        gpio_pin_set(gpio_dev, LCD_SI_PIN, (byte >> bit) & 1);
        gpio_pin_set(gpio_dev, LCD_SCL_PIN, 1);
        k_busy_wait(1);
        gpio_pin_set(gpio_dev, LCD_SCL_PIN, 0);
    }
    gpio_pin_set(gpio_dev, LCD_CS_PIN, 1);
}

// Helper functions
static void lcd_write_command(const struct device *gpio_dev, uint8_t cmd) {
    spi_send(gpio_dev, cmd, false);
}

static void lcd_write_data(const struct device *gpio_dev, uint8_t data) {
    spi_send(gpio_dev, data, true);
}

// Initialization (from your previous working code)
void lcd_init(const struct device *gpio_dev) {
    // Setup all pins as output and LOW
    gpio_pin_configure(gpio_dev, LCD_CS_PIN,  GPIO_OUTPUT_LOW);
    gpio_pin_configure(gpio_dev, LCD_RES_PIN, GPIO_OUTPUT_LOW);
    gpio_pin_configure(gpio_dev, LCD_A0_PIN,  GPIO_OUTPUT_LOW);
    gpio_pin_configure(gpio_dev, LCD_SCL_PIN, GPIO_OUTPUT_LOW);
    gpio_pin_configure(gpio_dev, LCD_SI_PIN,  GPIO_OUTPUT_LOW);

    // Reset sequence
    gpio_pin_set(gpio_dev, LCD_RES_PIN, 0);
    k_msleep(5);
    gpio_pin_set(gpio_dev, LCD_RES_PIN, 1);
    k_msleep(5);

    // Send LCD init commands (from your working code)
    lcd_write_command(gpio_dev, 0xA2);
    lcd_write_command(gpio_dev, 0xA0);
    lcd_write_command(gpio_dev, 0xC8);
    lcd_write_command(gpio_dev, 0x40);
    lcd_write_command(gpio_dev, 0x25);
    lcd_write_command(gpio_dev, 0x81);
    lcd_write_command(gpio_dev, 0x19);
    lcd_write_command(gpio_dev, 0x2F);
    lcd_write_command(gpio_dev, 0xAF);
}

// Set current page (0-7)
void lcd_set_page(const struct device *gpio_dev, uint8_t page) {
    lcd_write_command(gpio_dev, 0xB0 | (page & 0x07));
}

// Set current column (0-127)
void lcd_set_column(const struct device *gpio_dev, uint8_t col) {
    lcd_write_command(gpio_dev, 0x10 | ((col >> 4) & 0x0F));
    lcd_write_command(gpio_dev, 0x00 | (col & 0x0F));
}

// Clear display (set all pixels off)
void lcd_clear(const struct device *gpio_dev) {
    for (uint8_t page = 0; page < 8; page++) {
        lcd_set_page(gpio_dev, page);
        lcd_set_column(gpio_dev, 0);
        for (uint8_t col = 0; col < 128; col++) {
            lcd_write_data(gpio_dev, 0x00);
        }
    }
}

// Draw a single char from font table at page, column
void lcd_draw_char(const struct device *gpio_dev, uint8_t page, uint8_t col, char c) {
    lcd_set_page(gpio_dev, page);
    lcd_set_column(gpio_dev, col);

    // Handle font lookup (assume font8, adjust as needed)
    uint8_t idx = (uint8_t)c;
    if (idx < 32 || idx > 126) idx = 32; // blank for unprintables

    for (int i = 0; i < 8; i++) {
        lcd_write_data(gpio_dev, font8[idx - 32][i]);
    }
}

// Draw string at page, column (chars will wrap page if needed)
void lcd_draw_text(const struct device *gpio_dev, uint8_t page, uint8_t col, const char *str) {
    while (*str && col < 128) {
        lcd_draw_char(gpio_dev, page, col, *str++);
        col += 8; // for 8x8 font, adjust for 5x7, etc.
    }
}
```

## src/lcd.h
```c
#ifndef LCD_H_
#define LCD_H_

#include <zephyr/device.h>     // This fixes struct device visibility!
#include <zephyr/drivers/gpio.h> // This gets GPIO_OUTPUT_LOW and friends
#include <stdint.h>          // For uint8_t etc.
#include <stdbool.h>         // For bool type


void lcd_init(const struct device *gpio_dev);
void lcd_clear(const struct device *gpio_dev);
void lcd_set_page(const struct device *gpio_dev, uint8_t page);
void lcd_set_column(const struct device *gpio_dev, uint8_t col);
void lcd_draw_char(const struct device *gpio_dev, uint8_t page, uint8_t col, char c);
void lcd_draw_text(const struct device *gpio_dev, uint8_t page, uint8_t col, const char *str);

#endif // LCD_H_
```

## src/oxygen_sensor.c
```c
#include "oxygen_sensor.h"
#include <string.h>
#include <stdlib.h>
#include <zephyr/drivers/uart.h>
#include <zephyr/kernel.h>

static bool parse_measurement(const char *buf, float *conc, float *sat, float *temp) {
    const char *cptr, *sptr, *tptr;
    cptr = strstr(buf, "[uM]");
    if (!cptr) return false;
    *conc = strtof(cptr + 4, NULL);

    sptr = strstr(buf, "[%]");
    if (!sptr) return false;
    *sat = strtof(sptr + 3, NULL);

    tptr = strstr(buf, "[Deg.C]");
    if (!tptr) return false;
    *temp = strtof(tptr + 7, NULL);

    return true;
}

bool oxygen_read_from_uart(const struct device *uart_dev, float *conc, float *sat, float *temp) {
    static char buf[256];
    static int idx = 0;
    unsigned char c;

    // This while is only needed if you want to flush the whole UART buffer, else just poll once per main loop!
    while (uart_poll_in(uart_dev, &c) == 0) {
        if (c == '\n' || c == '\r') {
            if (idx > 0) {
                buf[idx] = '\0';
                idx = 0;
                if (strstr(buf, "MEASUR")) {
                    return parse_measurement(buf, conc, sat, temp);
                }
            }
        } else if (c >= 32 && c <= 126) {
            if (idx < sizeof(buf) - 1) buf[idx++] = c;
        } else if (c == '\t' && idx < sizeof(buf) - 1) {
            buf[idx++] = ' ';
        }
    }
    return false;
}
```

## src/oxygen_sensor.h
```c
#ifndef OXYGEN_SENSOR_H
#define OXYGEN_SENSOR_H

#include <zephyr/device.h>
#include <stdbool.h>

bool oxygen_read_from_uart(const struct device *uart_dev, float *conc, float *sat, float *temp);

#endif
```

## src/turbidity_sensor.c
```c
#include "turbidity_sensor.h"
#include <zephyr/kernel.h>
#include <zephyr/sys/printk.h>
#include <string.h>
#include <stdint.h>

// CRC calculation for Modbus RTU
uint16_t modbus_crc16(const uint8_t *buf, uint16_t len) {
    uint16_t crc = 0xFFFF;
    for (int pos = 0; pos < len; pos++) {
        crc ^= (uint16_t)buf[pos];
        for (int i = 8; i != 0; i--) {
            if ((crc & 0x0001) != 0) {
                crc >>= 1;
                crc ^= 0xA001;
            } else {
                crc >>= 1;
            }
        }
    }
    return crc;
}

// Builds a standard Modbus query for reading 2 registers (turbidity+temp)
void send_modbus_read(uint8_t *tx_buf, size_t *tx_len) {
    tx_buf[0] = 0x01;      // address (change if needed)
    tx_buf[1] = 0x03;      // function: read holding registers
    tx_buf[2] = 0x00;      // reg high
    tx_buf[3] = 0x00;      // reg low (start at 0x0000)
    tx_buf[4] = 0x00;      // number of regs high
    tx_buf[5] = 0x02;      // number of regs low (read 2 regs: turbidity+temp)
    uint16_t crc = modbus_crc16(tx_buf, 6);
    tx_buf[6] = crc & 0xFF;
    tx_buf[7] = (crc >> 8) & 0xFF;
    *tx_len = 8;
}

// Read turbidity value from sensor via UART/RS485 (returns true if successful)
bool turbidity_read_from_uart(const struct device *uart_dev, const struct device *gpio_dev, uint8_t de_pin, float *turbidity) {
    uint8_t tx_buf[8];
    uint8_t rx_buf[16];
    size_t tx_len, rx_len;

    send_modbus_read(tx_buf, &tx_len);

    // Set DE high (transmit)
    gpio_pin_set(gpio_dev, de_pin, 1);
    k_sleep(K_MSEC(10));

    // Send query
    for (size_t i = 0; i < tx_len; i++)
        uart_poll_out(uart_dev, tx_buf[i]);
    k_sleep(K_MSEC(2));

    // Set DE low (receive)
    gpio_pin_set(gpio_dev, de_pin, 0);

    // Wait for response
    rx_len = 0;
    int timeout = 200; // ms
    int t = 0;
    while (t < timeout && rx_len < sizeof(rx_buf)) {
        uint8_t c;
        if (uart_poll_in(uart_dev, &c) == 0) {
            rx_buf[rx_len++] = c;
        } else {
            k_sleep(K_MSEC(2));
            t += 2;
        }
    }

    // Parse response (address, func, byte count, data[4], CRC[2])
    if (rx_len >= 9 && rx_buf[1] == 0x03 && rx_buf[2] == 0x04) {
        int turb_raw = (rx_buf[3] << 8) | rx_buf[4];
        *turbidity = turb_raw / 10.0f;
        return true;
    } else {
        return false;
    }
}

// Setup functions for baudrate configuration (optional/rarely used)
void build_set_baud9600(uint8_t *tx_buf, size_t *tx_len) {
    tx_buf[0] = 0x01;
    tx_buf[1] = 0x06;
    tx_buf[2] = 0x07;
    tx_buf[3] = 0xD1;
    tx_buf[4] = 0x00;
    tx_buf[5] = 0x02;
    uint16_t crc = modbus_crc16(tx_buf, 6);
    tx_buf[6] = crc & 0xFF;
    tx_buf[7] = (crc >> 8) & 0xFF;
    *tx_len = 8;
}

void turbidity_set_baud_9600(const struct device *uart_dev, const struct device *gpio_dev, uint8_t de_pin) {
    uint8_t tx_buf[8];
    uint8_t rx_buf[16];
    size_t tx_len, rx_len;

    build_set_baud9600(tx_buf, &tx_len);

    gpio_pin_set(gpio_dev, de_pin, 1);
    k_sleep(K_MSEC(10));
    for (size_t i = 0; i < tx_len; i++)
        uart_poll_out(uart_dev, tx_buf[i]);
    k_sleep(K_MSEC(2));
    gpio_pin_set(gpio_dev, de_pin, 0);

    rx_len = 0;
    int timeout = 200, t = 0;
    while (t < timeout && rx_len < sizeof(rx_buf)) {
        uint8_t c;
        if (uart_poll_in(uart_dev, &c) == 0) {
            rx_buf[rx_len++] = c;
        } else {
            k_sleep(K_MSEC(2));
            t += 2;
        }
    }
    printk("Sent frame to set baud to 9600.\n");
    printk("Raw bytes received (%d): ", rx_len);
    for (int i = 0; i < rx_len; i++) {
        printk("%02X ", rx_buf[i]);
    }
    printk("\n");
    if (rx_len == 8 && memcmp(rx_buf, tx_buf, 8) == 0) {
        printk("Success! Sensor replied with mirror frame. Baud rate now set to 9600.\n");
    } else {
        printk("Warning: Unexpected reply. Check connection and retry if needed.\n");
    }
    printk("** Now power-cycle or reset the sensor, and update your UART overlay and code to 9600. **\n");
    while (1) { k_sleep(K_SECONDS(1)); }
}
```

## src/turbidity_sensor.h
```c
#ifndef TURBIDITY_SENSOR_H
#define TURBIDITY_SENSOR_H

#include <zephyr/device.h>
#include <zephyr/drivers/gpio.h>
#include <zephyr/drivers/uart.h>
#include <stdint.h>
#include <stddef.h>

uint16_t modbus_crc16(const uint8_t *buf, uint16_t len);
void send_modbus_read(uint8_t *tx_buf, size_t *tx_len);
bool turbidity_read_from_uart(const struct device *uart_dev, const struct device *gpio_dev, uint8_t de_pin, float *turbidity);

void build_set_baud9600(uint8_t *tx_buf, size_t *tx_len);
void turbidity_set_baud_9600(const struct device *uart_dev, const struct device *gpio_dev, uint8_t de_pin);

#endif // TURBIDITY_SENSOR_H
```
